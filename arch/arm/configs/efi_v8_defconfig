## arch/arm/configs/efi_v8_defconfig
```kconfig
CONFIG_64BIT=y
CONFIG_CPU_V8=y
CONFIG_MMU=y
CONFIG_MALLOC_SIZE=0x0
CONFIG_NAME="efi_v8_defconfig"
CONFIG_EFI_PAYLOAD=y
CONFIG_FS_EFI=y
CONFIG_FS_EFIVARFS=y
CONFIG_DRIVER_SERIAL_EFI_STDIO=y
CONFIG_EFI_BLK=y
CONFIG_EFI_BLK_SEPARATE_USBDISK=y
CONFIG_WATCHDOG_EFI=y
CONFIG_HW_RANDOM_EFI=y
CONFIG_I2C_EFI=y
CONFIG_VIDEO=y
CONFIG_DRIVER_VIDEO_EFI_GOP=y
CONFIG_CLOCKSOURCE_EFI=y
CONFIG_SERIAL_EFI_STDIO=y
CONFIG_CMD_EFI_HANDLE_DUMP=y
CONFIG_BOOTM_FITIMAGE=y
CONFIG_PROMPT_HUSH_PS2="y"
CONFIG_CMDLINE_EDITING=y
CONFIG_BOOTM_SHOW_TYPE=y
CONFIG_BOOTM_VERBOSE=y
CONFIG_CONSOLE_ACTIVATE_ALL=y
CONFIG_CONSOLE_ALLOW_COLOR=y
CONFIG_PBL_CONSOLE=y
CONFIG_PROMPT="barebox> "
CONFIG_HUSH_FANCY_PROMPT=y
CONFIG_AUTO_COMPLETE=y
CONFIG_PARTITION_DISK_EFI=y
CONFIG_MENU=y
CONFIG_BOOTM_INITRD=y
CONFIG_BOOTM_OFTREE=y
CONFIG_BLSPEC=y
CONFIG_ARM_OPTIMZED_STRING_FUNCTIONS=y
CONFIG_ARM_PSCI_CLIENT=y
CONFIG_KALLSYMS=y
CONFIG_BOOTM_AIMAGE=y
CONFIG_BLSPEC=y
CONFIG_CONSOLE_ACTIVATE_ALL_FALLBACK=y
CONFIG_CONSOLE_RATP=y
CONFIG_DEFAULT_ENVIRONMENT_GENERIC_NEW=y
CONFIG_STATE=y
CONFIG_BOOTCHOOSER=y
CONFIG_RESET_SOURCE=y
CONFIG_MACHINE_ID=y
CONFIG_FASTBOOT_SPARSE=y
CONFIG_CMD_DMESG=y
CONFIG_LONGHELP=y
CONFIG_CMD_IOMEM=y
CONFIG_CMD_IMD=y
CONFIG_CMD_MEMINFO=y
CONFIG_CMD_ARM_MMUINFO=y
CONFIG_CMD_REGULATOR=y
CONFIG_CMD_BFETCH=y
CONFIG_CMD_MMC_EXTCSD=y
CONFIG_CMD_POLLER=y
CONFIG_CMD_SLICE=y
CONFIG_CMD_GO=y
CONFIG_CMD_LOADB=y
CONFIG_CMD_RESET=y
CONFIG_CMD_BOOTCHOOSER=y
CONFIG_CMD_PARTITION=y
CONFIG_CMD_FINDMNT=y
CONFIG_CMD_EXPORT=y
CONFIG_CMD_DEFAULTENV=y
CONFIG_CMD_LOADENV=y
CONFIG_CMD_PRINTENV=y
CONFIG_CMD_MAGICVAR=y
CONFIG_CMD_MAGICVAR_HELP=y
CONFIG_CMD_SAVEENV=y
CONFIG_CMD_FILETYPE=y
CONFIG_CMD_LN=y
CONFIG_CMD_MD5SUM=y
CONFIG_CMD_SHA1SUM=y
CONFIG_CMD_SHA224SUM=y
CONFIG_CMD_SHA256SUM=y
CONFIG_CMD_UNCOMPRESS=y
CONFIG_CMD_LET=y
CONFIG_CMD_MSLEEP=y
CONFIG_CMD_READF=y
CONFIG_CMD_SLEEP=y
CONFIG_CMD_DHCP=y
CONFIG_CMD_MIITOOL=y
CONFIG_CMD_PING=y
CONFIG_CMD_TFTP=y
CONFIG_CMD_ECHO_E=y
CONFIG_CMD_EDIT=y
CONFIG_CMD_LOGIN=y
CONFIG_CMD_MENU=y
CONFIG_CMD_MENU_MANAGEMENT=y
CONFIG_CMD_MENUTREE=y
CONFIG_CMD_PASSWD=y
CONFIG_CMD_SPLASH=y
CONFIG_CMD_FBTEST=y
CONFIG_CMD_READLINE=y
CONFIG_CMD_TIMEOUT=y
CONFIG_CMD_CRC=y
CONFIG_CMD_CRC_CMP=y
CONFIG_CMD_MEMTEST=y
CONFIG_CMD_MM=y
CONFIG_CMD_CLK=y
CONFIG_CMD_DETECT=y
CONFIG_CMD_FLASH=y
CONFIG_CMD_GPIO=y
CONFIG_CMD_I2C=y
CONFIG_CMD_LED=y
CONFIG_CMD_POWEROFF=y
CONFIG_CMD_SMC=y
CONFIG_CMD_LED_TRIGGER=y
CONFIG_CMD_USBGADGET=y
CONFIG_CMD_WD=y
CONFIG_CMD_BAREBOX_UPDATE=y
CONFIG_CMD_FIRMWARELOAD=y
CONFIG_CMD_OF_DIFF=y
CONFIG_CMD_OF_NODE=y
CONFIG_CMD_OF_PROPERTY=y
CONFIG_CMD_OF_DISPLAY_TIMINGS=y
CONFIG_CMD_OF_FIXUP_STATUS=y
CONFIG_CMD_OF_OVERLAY=y
CONFIG_CMD_OFTREE=y
CONFIG_CMD_TIME=y
CONFIG_NET=y
CONFIG_NET_NETCONSOLE=y
CONFIG_NET_SNTP=y
CONFIG_NET_FASTBOOT=y
CONFIG_NET_9P=y
CONFIG_NET_9P_VIRTIO=y
CONFIG_DEEP_PROBE_DEFAULT=y
CONFIG_OF_BAREBOX_DRIVERS=y
CONFIG_OF_BAREBOX_ENV_IN_FS=y
CONFIG_OF_OVERLAY_LIVE=y
CONFIG_SERIAL_DEV_BUS=y
CONFIG_SERIAL_AMBA_PL011=y
CONFIG_DRIVER_SERIAL_NS16550=y
CONFIG_DRIVER_SERIAL_CADENCE=y
CONFIG_DRIVER_SERIAL_LPUART32=y
CONFIG_VIRTIO_CONSOLE=y
CONFIG_DRIVER_NET_TI_K3_AM65_CPSW_NUSS=y
CONFIG_DRIVER_NET_DESIGNWARE_IMX8=y
CONFIG_DRIVER_NET_DESIGNWARE_ROCKCHIP=y
CONFIG_DRIVER_NET_FEC_IMX=y
CONFIG_DRIVER_NET_FSL_ENETC=y
CONFIG_DRIVER_NET_FSL_FMAN=y
CONFIG_DRIVER_NET_MACB=y
CONFIG_DRIVER_NET_VIRTIO=y
CONFIG_DP83867_PHY=y
CONFIG_MICREL_PHY=y
CONFIG_REALTEK_PHY=y
CONFIG_SMSC_PHY=y
CONFIG_NET_DSA_MV88E6XXX=y
CONFIG_MDIO_BITBANG=y
CONFIG_MDIO_GPIO=y
CONFIG_MDIO_BUS_MUX_GPIO=y
CONFIG_NET_USB=y
CONFIG_NET_USB_ASIX=y
CONFIG_USB_NET_AX88179_178A=y
CONFIG_NET_USB_SMSC95XX=y
CONFIG_NET_USB_RTL8152=y
CONFIG_DRIVER_SPI_FSL_QUADSPI=y
CONFIG_DRIVER_SPI_IMX=y
CONFIG_SPI_NXP_FLEXSPI=y
CONFIG_I2C_GPIO=y
CONFIG_I2C_IMX=y
CONFIG_I2C_OMAP=y
CONFIG_I2C_RK3X=y
CONFIG_I2C_MUX=y
CONFIG_I2C_MUX_PCA954x=y
CONFIG_MTD=y
CONFIG_MTD_CONCAT=y
CONFIG_MTD_M25P80=y
CONFIG_DRIVER_CFI=y
CONFIG_CFI_BUFFER_WRITE=y
CONFIG_VIRTIO_BLK=y
CONFIG_USB_HOST=y
CONFIG_USB_IMX_CHIPIDEA=y
CONFIG_USB_DWC3=y
CONFIG_USB_DWC3_DUAL_ROLE=y
CONFIG_USB_EHCI=y
CONFIG_USB_STORAGE=y
CONFIG_USB_ONBOARD_DEV=y
CONFIG_USB_GADGET=y
CONFIG_USB_GADGET_SERIAL=y
CONFIG_USB_GADGET_FASTBOOT=y
CONFIG_USB_GADGET_MASS_STORAGE=y
CONFIG_VIDEO=y
CONFIG_FRAMEBUFFER_CONSOLE=y
CONFIG_DRIVER_VIDEO_BOCHS_PCI=y
CONFIG_SOUND=y
CONFIG_MCI=y
CONFIG_MCI_MMC_BOOT_PARTITIONS=y
CONFIG_MCI_DW=y
CONFIG_MCI_SUNXI_SMHC=y
CONFIG_MCI_ROCKCHIP_DWCMSHC=y
CONFIG_MCI_IMX_ESDHC=y
CONFIG_MCI_ARASAN=y
CONFIG_MCI_AM654=y
CONFIG_COMMON_CLK=y
CONFIG_COMMON_CLK_SCMI=y
CONFIG_MFD_ACT8846=y
CONFIG_RAVE_SP_CORE=y
CONFIG_MFD_PCA9450=y
CONFIG_MFD_RK808=y
CONFIG_LED=y
CONFIG_LED_GPIO=y
CONFIG_LED_GPIO_OF=y
CONFIG_LED_TRIGGERS=y
CONFIG_LED_PCA955X=y
CONFIG_EEPROM_AT25=y
CONFIG_EEPROM_AT24=y
CONFIG_VIRTIO_INPUT=y
CONFIG_WATCHDOG=y
CONFIG_WATCHDOG_POLLER=y
CONFIG_WATCHDOG_DW=y
CONFIG_WATCHDOG_IMX=y
CONFIG_WATCHDOG_IMXULP=y
CONFIG_RAVE_SP_WATCHDOG=y
CONFIG_K3_RTI_WDT=y
CONFIG_HWRNG=y
CONFIG_HW_RANDOM_VIRTIO=y
CONFIG_DMADEVICES=y
CONFIG_TI_K3_UDMA=y
CONFIG_GPIO_PCA953X=y
CONFIG_GPIO_ZYNQ=y
CONFIG_PINCTRL_SINGLE=y
CONFIG_NVMEM_RMEM=y
CONFIG_IMX_OCOTP_ELE=y
CONFIG_RAVE_SP_EEPROM=y
CONFIG_REGULATOR=y
CONFIG_REGULATOR_FIXED=y
CONFIG_REGULATOR_ARM_SCMI=y
CONFIG_REGULATOR_RK808=y
CONFIG_RESET_IMX7=y
CONFIG_PCI_ECAM_GENERIC=y
CONFIG_RTC_CLASS=y
CONFIG_RTC_DRV_DS1307=y
CONFIG_FIRMWARE_ZYNQMP_FPGA=y
CONFIG_ARM_SCMI_PROTOCOL=y
CONFIG_GENERIC_PHY=y
CONFIG_USB_NOP_XCEIV=y
CONFIG_PHY_ROCKCHIP_INNO_USB2=y
CONFIG_PHY_ROCKCHIP_NANENG_COMBO_PHY=y
CONFIG_ROCKCHIP_IODOMAIN=y
CONFIG_TI_SCI_PM_DOMAINS=y
CONFIG_NVMEM_REBOOT_MODE=y
CONFIG_VIRTIO_MMIO=y
CONFIG_VIRTIO_PCI=y
CONFIG_MAILBOX=y
CONFIG_FS_CRAMFS=y
CONFIG_FS_EXT4=y
CONFIG_FS_TFTP=y
CONFIG_FS_NFS=y
CONFIG_9P_FS=y
CONFIG_9P_FS_WRITE=y
CONFIG_FS_FAT=y
CONFIG_FS_FAT_WRITE=y
CONFIG_FS_BPKFS=y
CONFIG_FS_UIMAGEFS=y
CONFIG_FS_PSTORE=y
CONFIG_FS_PSTORE_CONSOLE=y
CONFIG_FS_RATP=y
CONFIG_LZO_DECOMPRESS=y
CONFIG_DIGEST_SHA1_ARM64_CE=y
CONFIG_DIGEST_SHA256_ARM64_CE=y
CONFIG_MALLOC_EFI=y
# CONFIG_MALLOC_TLSF is not set
# CONFIG_MISSING_FIRMWARE_ERROR is not set
```

## arch/arm/mach-efi/Kconfig
```kconfig
config EFI_ARM64
	bool "EFI on ARM64"
	select CPU_V8
	select CPU_SUPPORTS_64BIT_KERNEL
	select HAVE_EFI_PAYLOAD
	select EFI_PAYLOAD
	select BOOTM_FITIMAGE
    select CLOCKSOURCE_EFI
	depends on 64BIT
	default y
```

## arch/arm/mach-tegra/Kconfig
```kconfig
# SPDX-License-Identifier: GPL-2.0-only

if ARCH_TEGRA

# ---------------------------------------------------------

config ARCH_TEGRA_2x_SOC
	bool
	depends on 32BIT
	select CPU_V7

config ARCH_TEGRA_3x_SOC
	bool
	depends on 32BIT
	select CPU_V7

config ARCH_TEGRA_124_SOC
	bool
	depends on 32BIT
	select CPU_V7

config ARCH_TEGRA_234_SOC
	bool
	depends on 64BIT
	select CPU_V8
	select CPU_SUPPORTS_64BIT_KERNEL

menu "select Tegra boards to be built"

config MACH_TORADEX_COLIBRI_T20
	bool "Toradex Colibri T20"
	select ARCH_TEGRA_2x_SOC

config MACH_TOSHIBA_AC100
	bool "Toshiba AC100"
	select ARCH_TEGRA_2x_SOC

config MACH_NVIDIA_BEAVER
	bool "NVIDIA Beaver"
	select ARCH_TEGRA_3x_SOC
	select I2C
	select I2C_TEGRA

config MACH_NVIDIA_JETSON_234
	bool "NVIDIA Jetson on T234"
	select ARCH_TEGRA_234_SOC
	select I2C
	select I2C_TEGRA

endmenu

# ---------------------------------------------------------

endif
```

## efi/payload/Kconfig
```kconfig
config EFI_HANDOVER_PROTOCOL
	bool "EFI Handover protocol"
	def_bool !EFI_PAYLOAD_BOOTM

config EFI_PAYLOAD_BOOTM
	bool "EFI bootm protocol"
	def_bool y
	select BOOTM_FITIMAGE
```

## fs/btrfs/Kconfig
```kconfig
# SPDX-License-Identifier: GPL-2.0-only

config FS_BTRFS
	bool
	prompt "btrfs filesystem support"
```
