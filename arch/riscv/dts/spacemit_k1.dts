// SPDX-License-Identifier: (GPL-2.0 OR MIT)
/*
 * Copyright (C) 2024 Yangyu Chen <cyy@cyyself.name>
 * Copyright (C) 2025 Hendrik Hamerlinck <hendrik.hamerlinck@hammernet.be>
 */

/dts-v1/;

#include "k1.dtsi"
#include "k1-pinctrl.dtsi"

/ {
	model = "Spacemit K1";
	compatible = "spacemit,k1";
	barebox,disable-deep-probe;

	aliases {
		serial0 = &uart0;
	};

	chosen {
		stdout-path = "serial0";
	};
/*
	leds {
		compatible = "gpio-leds";

		led1 {
			label = "sys-led";
			gpios = <&gpio K1_GPIO(96) GPIO_ACTIVE_LOW>;
			linux,default-trigger = "heartbeat";
			default-state = "on";
		};
	};
*/
};

&uart0 {
	pinctrl-names = "default";
	pinctrl-0 = <&uart0_2_cfg>;
	status = "okay";
};
