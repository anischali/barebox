## drivers/crypto/Kconfig
```kconfig
# SPDX-License-Identifier: GPL-2.0-only

menu "Hardware crypto devices"

source "drivers/crypto/caam/Kconfig"
source "drivers/crypto/imx-scc/Kconfig"
source "drivers/crypto/optee-pkcs11/Kconfig"

endmenu
```

## drivers/crypto/optee-pkcs11/Kconfig
```kconfig
config OPTEE_PKCS11
    bool "OPTEE pkcs11 driver"
    depends on TEE
    select CRYPTO_PKCS11
    help
        Support for PKCS11 crypto engine to perform encryption operations, it wi
        provide a basic crypto ops for the supported algos.
```

## images/barebox-standalone.its
```
/dts-v1/;

/ {
	description = "U-boot FIT image for k1x";
	#address-cells = <2>;
	fit,fdt-list = "of-list";

	images {
		barebox {
			description = "barebox";
			type = "standalone";
			os = "barebox";
			arch = "riscv";
			compression = "none";
			load = <0x0 0x00200000>;
			data = /incbin/("./barebox-spacemit-k1.img");
			hash-1 {
				algo = "crc32";
			};
		};
	};

	configurations {
		default = "conf_1";

		conf_1 {
			description = "barebox standalone";
			loadables = "barebox";
			hash-1 {
				algo = "crc32";
			};
		};
	};
};
```
